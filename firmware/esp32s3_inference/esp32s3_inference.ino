// SignSense on-device inference firmware (TensorFlow Lite Micro)
//
// Runs on a classic ESP32 WITHOUT PSRAM (ESP32-D0WD-V3) as well as on an ESP32-S3.
//
//   core 0: sampler task, reads the IMU every 10 ms into a 1 s ring buffer
//   core 1: every 50 new samples (0.5 s, 50 % overlap) -> copy window -> normalise -> Invoke()
//           -> decision (threshold, cooldown, rest suppression) -> #PRED line on serial
//
// The 279 ms Invoke() therefore never delays sampling (99.9 Hz, 0 samples lost).
//
// gesture_model.h and model_config.h are GENERATED by python/export_model.py: they hold the
// model bytes, class order, normalisation constants and quantization parameters, so the
// firmware always matches training. Set MODEL_IS_INT8 there via `export_model.py --deploy int8`.
//
// Serial output (115200 baud), parsed by python/inference_server.py:
//   #CLASSES,come,hello,help,please,rest,thank_you,yes
//   #PRED,<t_ms>,<label>,<confidence>,<accepted 0/1>,<invoke_us>,<p0>,...,<pN-1>
//   #STAT,invoke_avg_us=..,invoke_min_us=..,invoke_max_us=..,pre_us=..,arena=..,heap=..,
//         rate_hz=..,lost=..,bad_reads=..,reinit=..,threshold=..
//
// Serial commands:  t 0.84 = set threshold   c = recalibrate gyro   s = stats now
//                   w = window diagnostics   q = toggle quiet (only #PRED of accepted signs)
//
// Arduino IDE: board "ESP32 Dev Module", Partition Scheme "Huge APP (3MB No OTA)",
// PSRAM disabled, upload speed 115200. Library: TensorFlowLite_ESP32 (patched for ESP32
// core 3.x, see PROJECT_REPORT.md Section 11.5).
//
// TensorFlowLite_ESP32 (2022) patches for ESP32 Arduino core 3.x. Edit the installed library
// (Documents/Arduino/libraries/TensorFlowLite_ESP32/src), follow the compiler error for the
// exact file and line, and keep a .orig backup of every file you touch:
//   1. const flatbuffers member (third_party/flatbuffers/.../flatbuffers.h): remove the `const`
//      from the member the compiler refuses to assign in the copy/move assignment operator.
//   2. unused LCD / camera drivers shipped with the library: rename them to .cpp.disabled; they
//      include headers that no longer exist in core 3.x and inference does not need them.
//   3. private operator delete (TF_LITE_REMOVE_VIRTUAL_DELETE in micro_interpreter.h /
//      micro_allocator.h): make it public. This sketch builds the interpreter with placement
//      new into a static buffer, so it never calls delete.

#include <new>
#include <TensorFlowLite_ESP32.h>
#include "tensorflow/lite/micro/all_ops_resolver.h"
#include "tensorflow/lite/micro/micro_error_reporter.h"
#include "tensorflow/lite/micro/micro_interpreter.h"
#include "tensorflow/lite/schema/schema_generated.h"

#include "esp_heap_caps.h"
#include "esp_timer.h"
#include "imu.h"
#include "gesture_model.h"
#include "model_config.h"

// ------------------------------------------------------------------ settings
static const size_t kArenaSize = 48 * 1024;  // measured use ≈ 28 KB (float32 Flatten model)
static const uint32_t SAMPLE_PERIOD_MS = 1000 / SAMPLE_RATE_HZ;
static const uint32_t STATS_PERIOD_MS = 10000;
static const uint16_t BAD_READS_BEFORE_REINIT = 20;

// ------------------------------------------------------------------ shared with sampler (core 0)
static float ring[WINDOW_SIZE][NUM_AXES];
static volatile uint32_t total_samples = 0;   // samples written since boot
static volatile uint32_t valid_run = 0;       // consecutive good samples since last sensor fault
static volatile uint32_t lost_samples = 0;
static volatile uint32_t bad_reads = 0;
static volatile uint32_t reinit_count = 0;
static volatile bool calib_request = false;
static volatile int calib_result = 0;         // 1 ok, -1 refused (moving)
static portMUX_TYPE ring_mux = portMUX_INITIALIZER_UNLOCKED;

// ------------------------------------------------------------------ TFLM
static tflite::MicroErrorReporter micro_error_reporter;
static tflite::ErrorReporter* error_reporter = &micro_error_reporter;
static const tflite::Model* model = nullptr;
static tflite::MicroInterpreter* interpreter = nullptr;
static TfLiteTensor* input = nullptr;
static TfLiteTensor* output = nullptr;
static uint8_t* tensor_arena = nullptr;
alignas(tflite::MicroInterpreter) static uint8_t interpreter_buf[sizeof(tflite::MicroInterpreter)];

// ------------------------------------------------------------------ decision + stats
static float threshold = DEFAULT_THRESHOLD;
static bool quiet = false;
static uint32_t last_accept_ms = 0;
static uint32_t last_infer_at = 0;
static float window_buf[WINDOW_SIZE][NUM_AXES];
static float probs[NUM_CLASSES];

static uint64_t st_invoke_sum = 0;
static uint32_t st_invoke_min = UINT32_MAX, st_invoke_max = 0, st_invokes = 0, st_pre_us = 0;
static uint32_t st_last_ms = 0, st_last_samples = 0;

// ================================================================== sampler task (core 0)
void samplerTask(void*) {
  TickType_t last_wake = xTaskGetTickCount();
  uint16_t bad_in_row = 0;
  for (;;) {
    if (calib_request) {
      calib_result = imu::calibrateGyro(200, 1.0f, 0.02f) ? 1 : -1;
      calib_request = false;
      last_wake = xTaskGetTickCount();
    }
    // xTaskDelayUntil returns pdFALSE if the deadline had already passed (we were late)
    if (xTaskDelayUntil(&last_wake, pdMS_TO_TICKS(SAMPLE_PERIOD_MS)) == pdFALSE) lost_samples++;

    imu::Sample s;
    imu::Status st = imu::read(s);
    if (st != imu::READ_OK) {
      bad_reads++;
      valid_run = 0;  // never feed garbage from a loose wire to the model
      if (++bad_in_row >= BAD_READS_BEFORE_REINIT) {
        if (imu::begin(false)) reinit_count++;
        bad_in_row = 0;
      }
      continue;
    }
    bad_in_row = 0;
    portENTER_CRITICAL(&ring_mux);
    uint32_t i = total_samples % WINDOW_SIZE;
    ring[i][0] = s.ax; ring[i][1] = s.ay; ring[i][2] = s.az;
    ring[i][3] = s.gx; ring[i][4] = s.gy; ring[i][5] = s.gz;
    total_samples++;
    valid_run++;
    portEXIT_CRITICAL(&ring_mux);
  }
}

// ================================================================== helpers
static void copyWindow() {
  portENTER_CRITICAL(&ring_mux);
  uint32_t start = total_samples;  // oldest sample sits at total % WINDOW
  for (uint32_t k = 0; k < WINDOW_SIZE; k++) {
    uint32_t i = (start + k) % WINDOW_SIZE;
    for (int a = 0; a < NUM_AXES; a++) window_buf[k][a] = ring[i][a];
  }
  portEXIT_CRITICAL(&ring_mux);
}

static void preprocess() {
#if MODEL_IS_INT8
  int8_t* dst = input->data.int8;
  for (int k = 0; k < WINDOW_SIZE; k++)
    for (int a = 0; a < NUM_AXES; a++) {
      float x = (window_buf[k][a] - NORM_MEAN[a]) / NORM_STD[a];
      int32_t q = (int32_t)lroundf(x / INPUT_SCALE) + INPUT_ZERO_POINT;
      dst[k * NUM_AXES + a] = (int8_t)(q < -128 ? -128 : (q > 127 ? 127 : q));
    }
#else
  float* dst = input->data.f;
  for (int k = 0; k < WINDOW_SIZE; k++)
    for (int a = 0; a < NUM_AXES; a++) dst[k * NUM_AXES + a] = (window_buf[k][a] - NORM_MEAN[a]) / NORM_STD[a];
#endif
}

static void readOutput() {
  for (int c = 0; c < NUM_CLASSES; c++) {
#if MODEL_IS_INT8
    probs[c] = (output->data.int8[c] - OUTPUT_ZERO_POINT) * OUTPUT_SCALE;
#else
    probs[c] = output->data.f[c];
#endif
  }
}

static void printClasses() {
  Serial.print("#CLASSES");
  for (int c = 0; c < NUM_CLASSES; c++) {
    Serial.print(',');
    Serial.print(CLASS_NAMES[c]);
  }
  Serial.println();
}

static void printStats() {
  uint32_t now = millis();
  float secs = (now - st_last_ms) / 1000.0f;
  uint32_t samples = total_samples;
  float rate = secs > 0 ? (samples - st_last_samples) / secs : 0;
  Serial.printf("#STAT,invoke_avg_us=%u,invoke_min_us=%u,invoke_max_us=%u,pre_us=%u,arena=%u,heap=%u,"
                "rate_hz=%.1f,lost=%u,bad_reads=%u,reinit=%u,threshold=%.2f,int8=%d\n",
                st_invokes ? (uint32_t)(st_invoke_sum / st_invokes) : 0, st_invokes ? st_invoke_min : 0,
                st_invoke_max, st_pre_us, (unsigned)interpreter->arena_used_bytes(),
                (unsigned)ESP.getFreeHeap(), rate, (unsigned)lost_samples, (unsigned)bad_reads,
                (unsigned)reinit_count, threshold, MODEL_IS_INT8);
  st_invoke_sum = 0;
  st_invokes = 0;
  st_invoke_min = UINT32_MAX;
  st_invoke_max = 0;
  st_last_ms = now;
  st_last_samples = samples;
}

static void printWindowDiagnostics() {
  copyWindow();
  Serial.println("# window diagnostics (raw mean / std per axis, then normalised mean)");
  const char* names[NUM_AXES] = {"ax", "ay", "az", "gx", "gy", "gz"};
  for (int a = 0; a < NUM_AXES; a++) {
    float m = 0, ss = 0;
    for (int k = 0; k < WINDOW_SIZE; k++) m += window_buf[k][a];
    m /= WINDOW_SIZE;
    for (int k = 0; k < WINDOW_SIZE; k++) ss += (window_buf[k][a] - m) * (window_buf[k][a] - m);
    Serial.printf("#   %s  mean %8.3f  std %7.3f  norm-mean %6.2f\n", names[a], m, sqrtf(ss / WINDOW_SIZE),
                  (m - NORM_MEAN[a]) / NORM_STD[a]);
  }
  Serial.printf("#   valid_run %u  bias %.2f / %.2f / %.2f deg/s\n", (unsigned)valid_run, imu::gyro_bias[0],
                imu::gyro_bias[1], imu::gyro_bias[2]);
}

static void handleSerial() {
  static char line[32];
  static uint8_t len = 0;
  while (Serial.available()) {
    char ch = Serial.read();
    if (ch != '\n' && ch != '\r') {
      if (len < sizeof(line) - 1) line[len++] = ch;
      continue;
    }
    line[len] = 0;
    if (len == 0) continue;
    len = 0;
    if (line[0] == 't') {
      float v = atof(line + 1);
      if (v > 0 && v < 1) threshold = v;
      Serial.printf("# threshold = %.2f\n", threshold);
    } else if (line[0] == 'c') {
      Serial.println("# recalibrating gyro: keep the sensor STILL");
      calib_result = 0;
      calib_request = true;
      while (calib_request) delay(10);
      Serial.println(calib_result > 0 ? "# calibration OK" : "# sensor moved: calibration refused");
    } else if (line[0] == 's') {
      printClasses();
      printStats();
    } else if (line[0] == 'w') {
      printWindowDiagnostics();
    } else if (line[0] == 'q') {
      quiet = !quiet;
      Serial.printf("# quiet %s\n", quiet ? "on" : "off");
    }
  }
}

static void halt(const char* why) {
  for (;;) {
    Serial.printf("[ERR] %s\n", why);
    delay(2000);
  }
}

// ================================================================== setup / loop (core 1)
void setup() {
  Serial.begin(115200);
  delay(300);
  Serial.println("\n=== SignSense inference firmware ===");

  while (!imu::begin()) {
    Serial.printf("[IMU] not found (WHO_AM_I 0x%02X) on SDA %d / SCL %d, retrying...\n", imu::who_am_i,
                  IMU_SDA_PIN, IMU_SCL_PIN);
    delay(1000);
  }
  Serial.printf("[IMU] %s (WHO_AM_I 0x%02X)\n", imu::chipName(), imu::who_am_i);
  while (!imu::calibrateGyro(200, 1.0f, 0.02f)) {
    Serial.println("[IMU] sensor moved during gyro calibration, keep it STILL...");
    delay(500);
  }
  Serial.printf("[IMU] gyro bias %.2f / %.2f / %.2f deg/s\n", imu::gyro_bias[0], imu::gyro_bias[1],
                imu::gyro_bias[2]);

  // ---- model
  model = tflite::GetModel(g_gesture_model);
  if (model->version() != TFLITE_SCHEMA_VERSION) halt("model schema version does not match TFLM");

  // tensor arena: PSRAM if the board has it, otherwise internal RAM
  tensor_arena = psramFound() ? (uint8_t*)ps_malloc(kArenaSize)
                              : (uint8_t*)heap_caps_malloc(kArenaSize, MALLOC_CAP_INTERNAL | MALLOC_CAP_8BIT);
  if (!tensor_arena) halt("could not allocate tensor arena");

  static tflite::AllOpsResolver resolver;
  interpreter = new (interpreter_buf)
      tflite::MicroInterpreter(model, resolver, tensor_arena, kArenaSize, error_reporter);
  if (interpreter->AllocateTensors() != kTfLiteOk) halt("AllocateTensors() failed: increase kArenaSize");
  input = interpreter->input(0);
  output = interpreter->output(0);

  // model / firmware mismatch protection
  const TfLiteType want = MODEL_IS_INT8 ? kTfLiteInt8 : kTfLiteFloat32;
  if (input->type != want || output->type != want) halt("tensor type does not match MODEL_IS_INT8");
  if (input->dims->size != 3 || input->dims->data[1] != WINDOW_SIZE || input->dims->data[2] != NUM_AXES)
    halt("input shape is not [1, WINDOW_SIZE, NUM_AXES]");
  if (output->dims->data[output->dims->size - 1] != NUM_CLASSES) halt("output size != NUM_CLASSES");

  Serial.printf("[TFLM] model %u bytes, %s, arena used %u / %u bytes (%s), free heap %u\n",
                g_gesture_model_len, MODEL_IS_INT8 ? "int8" : "float32",
                (unsigned)interpreter->arena_used_bytes(), (unsigned)kArenaSize,
                psramFound() ? "PSRAM" : "internal RAM", (unsigned)ESP.getFreeHeap());
  printClasses();

  // sampler on core 0, high priority; inference stays on core 1 (Arduino loop)
  xTaskCreatePinnedToCore(samplerTask, "sampler", 4096, nullptr, configMAX_PRIORITIES - 2, nullptr, 0);
  st_last_ms = millis();
}

void loop() {
  handleSerial();

  uint32_t total = total_samples;
  if (valid_run < WINDOW_SIZE || total - last_infer_at < INFERENCE_STRIDE) {
    vTaskDelay(1);
    if (millis() - st_last_ms >= STATS_PERIOD_MS) printStats();
    return;
  }
  last_infer_at = total;

  copyWindow();
  int64_t t0 = esp_timer_get_time();
  preprocess();
  int64_t t1 = esp_timer_get_time();
  if (interpreter->Invoke() != kTfLiteOk) {
    Serial.println("[ERR] Invoke() failed");
    return;
  }
  int64_t t2 = esp_timer_get_time();
  readOutput();

  uint32_t invoke_us = (uint32_t)(t2 - t1);
  st_pre_us = (uint32_t)(t1 - t0);
  st_invoke_sum += invoke_us;
  st_invokes++;
  if (invoke_us < st_invoke_min) st_invoke_min = invoke_us;
  if (invoke_us > st_invoke_max) st_invoke_max = invoke_us;

  int top = 0;
  for (int c = 1; c < NUM_CLASSES; c++)
    if (probs[c] > probs[top]) top = c;
  uint32_t now = millis();
  bool accepted = top != REST_INDEX && probs[top] >= threshold && now - last_accept_ms >= COOLDOWN_MS;
  if (accepted) last_accept_ms = now;

  if (!quiet || accepted) {
    Serial.printf("#PRED,%u,%s,%.3f,%d,%u", now, CLASS_NAMES[top], probs[top], accepted ? 1 : 0, invoke_us);
    for (int c = 0; c < NUM_CLASSES; c++) Serial.printf(",%.3f", probs[c]);
    Serial.println();
  }

  if (millis() - st_last_ms >= STATS_PERIOD_MS) printStats();
}
